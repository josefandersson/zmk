## app/boards/shields/andersson_alpha/Kconfig.defconfig
```kconfig
if SHIELD_ANDERSSON_ALPHA_LEFT

config ZMK_KEYBOARD_NAME
	default "Andersson Alpha"

config ZMK_SPLIT_ROLE_CENTRAL
	default y

endif

if SHIELD_ANDERSSON_ALPHA_LEFT || SHIELD_ANDERSSON_ALPHA_RIGHT

config ZMK_SPLIT
	default y

if ZMK_DISPLAY

config I2C
	default y

config SSD1306
	default y

config SSD1306_REVERSE_MODE
	default y

endif

endif
```

## app/boards/shields/andersson_alpha/Kconfig.shield
```kconfig
config SHIELD_ANDERSSON_ALPHA_LEFT
	def_bool $(shields_list_contains,andersson_alpha_left)

config SHIELD_ANDERSSON_ALPHA_RIGHT
	def_bool $(shields_list_contains,andersson_alpha_right)
```

## app/boards/shields/andersson_alpha_rev2/Kconfig.defconfig
```kconfig
if SHIELD_ANDERSSON_ALPHA_REV2_LEFT

config ZMK_KEYBOARD_NAME
	default "Alpha r.2"

config ZMK_SPLIT_ROLE_CENTRAL
	default y

endif

if SHIELD_ANDERSSON_ALPHA_REV2_LEFT || SHIELD_ANDERSSON_ALPHA_REV2_RIGHT

config ZMK_SPLIT
	default y

if ZMK_BACKLIGHT

config PWM
	default y

config LED_GPIO
	default y

endif # ZMK_BACKLIGHT

if ZMK_DISPLAY

config I2C
	default y

config SSD1306
	default y

config SSD1306_REVERSE_MODE
	default y

endif

endif
```

## app/boards/shields/andersson_alpha_rev2/Kconfig.shield
```kconfig
config SHIELD_ANDERSSON_ALPHA_REV2_LEFT
	def_bool $(shields_list_contains,andersson_alpha_rev2_left)

config SHIELD_ANDERSSON_ALPHA_REV2_RIGHT
	def_bool $(shields_list_contains,andersson_alpha_rev2_right)
```
